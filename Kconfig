## allocator/Kconfig
```kconfig
menu "allocator"

config ALLOCATOR_DEBUG
    bool "debug"

config ALLOC_ALLOCATORS_SIZE
    int "maximum different allocators"
    default 10

config ALLOC_ALLOCATIONS_SIZE
    int "maximum different allocations"
    default 100

config HEAP_UI_REDRAW_INTERVAL
    int "ui draw interval (ms)"
    default 500
endmenu
```

## build_id/Kconfig
```kconfig
menuconfig CM_BUILD_ID
    bool "build_id"

if CM_BUILD_ID
    config BUILD_ID_UI_REDRAW_INTERVAL
        int "ui draw interval (ms)"
        default 500
endif
```

## crash/Kconfig
```kconfig
menu "crash"

config CRASH_UNWIND_DEPTH
    int "maximum unwind depth"
    default 100

config CRASH_MESAGE_LENGTH
    int "maximum stored message length"
    default 200

endmenu
```

## glitch_text/Kconfig
```kconfig
menuconfig CM_GLITCH_TEXT
    bool "glitch text"

if CM_GLITCH_TEXT
    config GLITCH_TEXT_DEBUG
        bool "debug"

    config GLITCH_TEXT_N_WORKERS
        int "maximum instances"
        default 15

    config GLITCH_TEXT_TASK_INTERVAL
        int "task work interval (ms)"
endif
```

## keylog/Kconfig
```kconfig
menuconfig CM_KEYLOG
    bool "keylog"

if CM_KEYLOG
    config KEYLOG_SIZE
        int "maximum length"
        default 70

    config KEYLOG_UI_REDRAW_INTERVAL
        int "ui draw interval (ms)"
        default 100
endif
```

## logging/Kconfig
```kconfig
menuconfig CM_LOGGING
    bool "logging"

if CM_LOGGING
    config LOGGING_FORMAT
        string "format"
        default "[%LS] %M"
endif
```

## memory/Kconfig
```kconfig
menuconfig CM_MEMORY
    bool "memory"

if CM_MEMORY
    config FLASH_UI_REDRAW_INTERVAL
        int "ui draw interval (ms)"
        default 500
endif
```

## sanitizer/Kconfig
```kconfig
menu "sanitizer"

config KASAN_DEBUG
    bool "debug"

config KASAN_INIT_DELAY
    int "initialization delay (ms)"
    default 3000

config KASAN_REDZONE_SIZE
    int "size of redzones (bytes)"
    default 4

config KASAN_MALLOC_ARRAY_SIZE
    int "size of array tracking dynamic memory allocations"
    default 300

endmenu
```

## scrolling_text/Kconfig
```kconfig
menuconfig CM_SCROLLING_TEXT
    bool "scrolling text"

if CM_SCROLLING_TEXT
    config SCROLLING_TEXT_DEBUG
        bool "debug"

    config SCROLLING_TEXT_N_WORKERS
        int "maximum instances"
        default 15

    config SCROLLING_TEXT_TASK_INTERVAL
        int "task work interval (ms)"
endif
```

## ui/Kconfig
```kconfig
menuconfig CM_UI
    bool "ui"

if CM_UI
    config UI_DEBUG
        bool "debug"

    menu "layer"
        config UI_LAYER_REDRAW_INTERVAL
            int "layer draw interval (ms)"
            default 100
    endmenu
endif
```
